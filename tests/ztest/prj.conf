## CMakeLists.txt
```
# Ztest build of the portable sensor-manager core.
#
# Same core sources as the host CMake/ctest build and the nRF54L15 app, linked
# UNMODIFIED. The only target-specific bit is SM_PORT_ZEPHYR, which selects the
# k_spinlock / k_uptime backing in src/port/sm_port_zephyr.c -- the exact port
# the real firmware runs. Runs on native_sim (host) and, via Twister, on target.
#
#   west build -b native_sim -t run tests/ztest
#
cmake_minimum_required(VERSION 3.20.0)

find_package(Zephyr REQUIRED HINTS $ENV{ZEPHYR_BASE})
project(sensor_manager_ztest)

# The portable core lives two levels up, shared verbatim with the host tests
# and the firmware app. No copies, no forks: one source of truth.
set(CORE_DIR ${CMAKE_CURRENT_SOURCE_DIR}/../../src)

target_sources(app PRIVATE
  # Ported Ztest suites (harness swapped, assertion intent preserved).
  src/test_ringbuf.c
  src/test_sensor_manager.c
  src/test_ble_batch.c
  src/test_concurrency.c
  # Unmodified portable core + its Zephyr port.
  ${CORE_DIR}/sm_ringbuf.c
  ${CORE_DIR}/sensor_manager.c
  ${CORE_DIR}/sensor_sim.c
  ${CORE_DIR}/ble_batch.c
  ${CORE_DIR}/port/sm_port_zephyr.c
)

target_include_directories(app PRIVATE ${CORE_DIR})
target_compile_definitions(app PRIVATE SM_PORT_ZEPHYR)
```

## prj.conf
```kconfig
# Ztest framework. Everything else the suites need (kernel, threads, spinlocks,
# printk) is on by default on native_sim, so this stays minimal on purpose.
CONFIG_ZTEST=y
```

## src/test_ble_batch.c
```c
/*
 * BLE batch encoder tests, ported to Ztest. These pin the wire format, which is
 * a contract with a mobile team building in parallel: if a field moves, a test
 * fails here rather than a bug appearing in someone else's app three weeks
 * later. Assertion intent is unchanged from tests/test_ble_batch.c.
 */
#include <stddef.h>

#include <zephyr/ztest.h>

#include "ble_batch.h"
#include "sensor_manager.h"

static sensor_manager_t mgr;

static void fill_imu(sensor_manager_t *m, int n, uint64_t period_us)
{
    int i;

    for (i = 0; i < n; i++) {
        int16_t a[3] = {(int16_t)(100 + i), (int16_t)(-200 - i), 4096};
        int16_t g[3] = {(int16_t)(i), (int16_t)(-i), 0};
        sm_submit_imu(m, a, g, (uint64_t)i * period_us);
    }
}

ZTEST(ble_batch, imu_frame_header_and_records_are_exact)
{
    sm_imu_sample_t samples[32];
    uint8_t         frame[BLE_DEFAULT_PAYLOAD];
    size_t          consumed, len, n;

    zassert_equal(sm_init(&mgr, 0), SM_OK);
    fill_imu(&mgr, 4, 20000);

    n = sm_read_imu(&mgr, samples, 32);
    zassert_equal(n, 4);

    len = ble_batch_encode_imu(samples, n, 0, frame, sizeof(frame), &consumed);
    zassert_equal(consumed, 4);
    zassert_equal(len, BLE_BATCH_HDR_LEN + 4 * BLE_IMU_REC_LEN);

    zassert_equal(ble_batch_type(frame), BLE_BATCH_TYPE_IMU);
    zassert_equal(ble_batch_count(frame), 4);
    zassert_equal(ble_batch_first_seq(frame), 0);
    zassert_equal(ble_batch_base_time(frame), 0);
    zassert_equal(ble_batch_dropped(frame), 0);

    /* Record 0: dt 0 by definition, accel.x 100 (little-endian). */
    zassert_equal(frame[16] | (frame[17] << 8), 0);
    zassert_equal((int16_t)(frame[18] | (frame[19] << 8)), 100);
    /* Record 2: dt is the gap from record 1, i.e. one 50 Hz period. */
    {
        size_t off = BLE_BATCH_HDR_LEN + 2 * BLE_IMU_REC_LEN;
        zassert_equal(frame[off] | (frame[off + 1] << 8), 20000);
    }

    sm_deinit(&mgr);
}

/* Negative accelerations must survive the round trip as signed values. */
ZTEST(ble_batch, negative_values_encode_as_twos_complement)
{
    sm_imu_sample_t samples[4];
    uint8_t         frame[BLE_DEFAULT_PAYLOAD];
    size_t          consumed;

    zassert_equal(sm_init(&mgr, 0), SM_OK);
    fill_imu(&mgr, 1, 20000);
    sm_read_imu(&mgr, samples, 4);
    ble_batch_encode_imu(samples, 1, 0, frame, sizeof(frame), &consumed);

    /* accel.y was -200 */
    zassert_equal((int16_t)(frame[20] | (frame[21] << 8)), -200);
    sm_deinit(&mgr);
}

/*
 * The batching claim from the architecture doc, asserted rather than
 * asserted-in-prose: a 244-byte payload carries 16 IMU samples, which turns
 * 50 notifications/s into ~3.1/s at 50 Hz.
 */
ZTEST(ble_batch, payload_budget_yields_sixteen_imu_samples)
{
    sm_imu_sample_t samples[64];
    uint8_t         frame[BLE_DEFAULT_PAYLOAD];
    size_t          consumed, len, n;

    zassert_equal(BLE_IMU_MAX_RECORDS(BLE_DEFAULT_PAYLOAD), 16);

    zassert_equal(sm_init(&mgr, 0), SM_OK);
    fill_imu(&mgr, 40, 20000);
    n = sm_read_imu(&mgr, samples, 64);
    zassert_equal(n, 40);

    len = ble_batch_encode_imu(samples, n, 0, frame, sizeof(frame), &consumed);
    zassert_equal(consumed, 16); /* capped by payload, not by n */
    zassert_true(len <= BLE_DEFAULT_PAYLOAD);
    zassert_equal(ble_batch_count(frame), 16);
    sm_deinit(&mgr);
}

/* Partial packing must not lose the remainder: the caller releases only what
 * was consumed, so the rest goes out next frame. */
ZTEST(ble_batch, unconsumed_samples_survive_for_the_next_frame)
{
    sm_imu_sample_t samples[64];
    uint8_t         frame[BLE_DEFAULT_PAYLOAD];
    size_t          consumed;

    zassert_equal(sm_init(&mgr, 0), SM_OK);
    fill_imu(&mgr, 40, 20000);

    zassert_equal(sm_peek_imu(&mgr, samples, 64), 40);
    ble_batch_encode_imu(samples, 40, 0, frame, sizeof(frame), &consumed);
    zassert_equal(sm_release_imu(&mgr, consumed), 16);
    zassert_equal(sm_pending_imu(&mgr), 24);

    zassert_equal(sm_peek_imu(&mgr, samples, 64), 24);
    ble_batch_encode_imu(samples, 24, 0, frame, sizeof(frame), &consumed);
    zassert_equal(ble_batch_first_seq(frame), 16); /* continues the sequence */
    sm_deinit(&mgr);
}

/*
 * A gap longer than the u16 microsecond window must close the batch rather
 * than emit a wrapped delta. This is the "sensor was suspended" case.
 */
ZTEST(ble_batch, oversized_time_delta_closes_the_batch_early)
{
    sm_imu_sample_t samples[8];
    uint8_t         frame[BLE_DEFAULT_PAYLOAD];
    size_t          consumed, n;
    int16_t         a[3] = {1, 2, 3}, g[3] = {4, 5, 6};

    zassert_equal(sm_init(&mgr, 0), SM_OK);
    sm_submit_imu(&mgr, a, g, 0);
    sm_submit_imu(&mgr, a, g, 20000);
    sm_submit_imu(&mgr, a, g, 5000000); /* 5 s later: exceeds u16 us */

    n = sm_read_imu(&mgr, samples, 8);
    zassert_equal(n, 3);
    ble_batch_encode_imu(samples, n, 0, frame, sizeof(frame), &consumed);
    zassert_equal(consumed, 2); /* third sample deferred */
    zassert_equal(ble_batch_count(frame), 2);
    sm_deinit(&mgr);
}

ZTEST(ble_batch, temp_frame_uses_millisecond_deltas)
{
    sm_temp_sample_t samples[24];
    uint8_t          frame[BLE_DEFAULT_PAYLOAD];
    size_t           consumed, len, n;
    int              i;

    /* A full 244 B payload holds 38 temp records; 20 comfortably fit one. */
    zassert_equal(BLE_TEMP_MAX_RECORDS(BLE_DEFAULT_PAYLOAD), 38);

    zassert_equal(sm_init(&mgr, 0), SM_OK);
    for (i = 0; i < 20; i++) {
        sm_submit_temp(&mgr, 33000 + i * 10, (uint64_t)i * 1000000ull);
    }
    n = sm_read_temp(&mgr, samples, 24);
    zassert_equal(n, 20);

    len = ble_batch_encode_temp(samples, n, 0, frame, sizeof(frame), &consumed);
    /* All 20 fit: 16 + 20*6 = 136 bytes, and 19 s of span fits u16 ms. */
    zassert_equal(consumed, 20);
    zassert_equal(len, 136);
    zassert_equal(ble_batch_type(frame), BLE_BATCH_TYPE_TEMP);

    /* Record 3 is one 1 Hz period after record 2 => dt_ms 1000. */
    {
        size_t off = BLE_BATCH_HDR_LEN + 3 * BLE_TEMP_REC_LEN;
        zassert_equal(frame[off] | (frame[off + 1] << 8), 1000);
    }
    sm_deinit(&mgr);
}

/*
 * The temperature stream encodes deltas in milliseconds, so its overflow
 * threshold is a gap wider than 65.535 s, not 65.5 ms. A gap past the u16 ms
 * window must close the batch early exactly as the IMU path does for us.
 */
ZTEST(ble_batch, temp_oversized_time_delta_closes_the_batch_early)
{
    sm_temp_sample_t samples[8];
    uint8_t          frame[BLE_DEFAULT_PAYLOAD];
    size_t           consumed, n;

    zassert_equal(sm_init(&mgr, 0), SM_OK);
    sm_submit_temp(&mgr, 33000, 0);
    sm_submit_temp(&mgr, 33100, 1000000ull);   /* +1 s: fits u16 ms */
    sm_submit_temp(&mgr, 33200, 200000000ull); /* +199 s: exceeds u16 ms */

    n = sm_read_temp(&mgr, samples, 8);
    zassert_equal(n, 3);
    zassert_equal(ble_batch_encode_temp(samples, n, 0, frame, sizeof(frame), &consumed),
                  (size_t)(BLE_BATCH_HDR_LEN + 2 * BLE_TEMP_REC_LEN));
    zassert_equal(consumed, 2); /* third sample deferred */
    zassert_equal(ble_batch_count(frame), 2);
    sm_deinit(&mgr);
}

/* The temp encoder has its own argument-validation copy; pin it independently
 * of the IMU one so a change to either is caught. */
ZTEST(ble_batch, temp_encoder_rejects_degenerate_inputs)
{
    sm_temp_sample_t samples[4];
    uint8_t          frame[BLE_DEFAULT_PAYLOAD];
    uint8_t          tiny[BLE_BATCH_HDR_LEN + BLE_TEMP_REC_LEN - 1];
    size_t           consumed;

    zassert_equal(sm_init(&mgr, 0), SM_OK);
    sm_submit_temp(&mgr, 33000, 0);
    sm_submit_temp(&mgr, 33001, 1000000ull);
    sm_read_temp(&mgr, samples, 4);

    zassert_equal(ble_batch_encode_temp(samples, 0, 0, frame, sizeof(frame), &consumed), 0);
    zassert_equal(consumed, 0);
    zassert_equal(ble_batch_encode_temp(NULL, 2, 0, frame, sizeof(frame), &consumed), 0);
    zassert_equal(ble_batch_encode_temp(samples, 2, 0, NULL, sizeof(frame), &consumed), 0);
    /* Buffer too small for even a header plus one record. */
    zassert_equal(ble_batch_encode_temp(samples, 2, 0, tiny, sizeof(tiny), &consumed), 0);
    sm_deinit(&mgr);
}

ZTEST(ble_batch, dropped_count_reaches_the_phone_and_saturates)
{
    sm_imu_sample_t samples[SM_IMU_CAPACITY];
    uint8_t         frame[BLE_DEFAULT_PAYLOAD];
    sm_stats_t      st;
    size_t          consumed, n;

    zassert_equal(sm_init(&mgr, 0), SM_OK);
    fill_imu(&mgr, 130, 20000); /* 30 evicted */
    sm_get_stats(&mgr, &st);
    zassert_equal(st.imu.dropped, 30);

    n = sm_read_imu(&mgr, samples, SM_IMU_CAPACITY);
    ble_batch_encode_imu(samples, n, st.imu.dropped, frame, sizeof(frame), &consumed);
    zassert_equal(ble_batch_dropped(frame), 30);

    /* "At least 65535 lost" is true; a wrapped small number would be a lie. */
    ble_batch_encode_imu(samples, n, 1000000, frame, sizeof(frame), &consumed);
    zassert_equal(ble_batch_dropped(frame), 0xFFFF);
    sm_deinit(&mgr);
}

ZTEST(ble_batch, encoder_rejects_degenerate_inputs)
{
    sm_imu_sample_t samples[4];
    uint8_t         frame[BLE_DEFAULT_PAYLOAD];
    uint8_t         tiny[8];
    size_t          consumed;

    zassert_equal(sm_init(&mgr, 0), SM_OK);
    fill_imu(&mgr, 2, 20000);
    sm_read_imu(&mgr, samples, 4);

    zassert_equal(ble_batch_encode_imu(samples, 0, 0, frame, sizeof(frame), &consumed), 0);
    zassert_equal(consumed, 0);
    zassert_equal(ble_batch_encode_imu(NULL, 2, 0, frame, sizeof(frame), &consumed), 0);
    zassert_equal(ble_batch_encode_imu(samples, 2, 0, NULL, sizeof(frame), &consumed), 0);
    /* Buffer too small even for a header plus one record. */
    zassert_equal(ble_batch_encode_imu(samples, 2, 0, tiny, sizeof(tiny), &consumed), 0);
    sm_deinit(&mgr);
}

ZTEST_SUITE(ble_batch, NULL, NULL, NULL, NULL, NULL);
```

## src/test_concurrency.c
```c
/*
 * Concurrency stress, ported from the pthreads harness to Zephyr threads so it
 * runs under Ztest on native_sim against the real firmware port (SM_PORT_ZEPHYR,
 * k_spinlock). The producer/consumer logic and the assertions are the SAME as
 * tests/test_concurrency.c; only the threading primitives changed
 * (pthread_create -> k_thread_create, sched_yield -> k_yield).
 *
 * Two properties are checked, and they are different things:
 *
 *   1. Memory safety / no data races  - a sanitizer's job.
 *   2. Accounting integrity           - our job. Every sample that entered the
 *      manager must be accounted for exactly once as delivered, dropped, or
 *      still buffered. A ring buffer that loses a sample without incrementing
 *      `dropped` is the exact bug this test exists to catch, and it is
 *      invisible to a sanitizer.
 *
 * TSan NOTE: ThreadSanitizer instruments host pthreads, not the Zephyr kernel's
 * cooperatively/preemptively scheduled threads on native_sim, so race detection
 * is NOT preserved by this native_sim build -- it covers property (2). Property
 * (1)'s race coverage is retained by the host pthreads variant
 * (tests/test_concurrency.c built as test_concurrency_tsan via
 * `cmake -DSM_SANITIZERS=ON`). See tests/ztest/README.md.
 *
 * Records also carry an internal consistency relation so a torn read (a
 * consumer observing half of one sample and half of another) is detectable.
 */
#include <stdatomic.h>
#include <stdbool.h>

#include <zephyr/kernel.h>
#include <zephyr/ztest.h>

#include "sensor_manager.h"

#define STRESS_SAMPLES 20000

/* One stack per concurrent worker. The busiest case (producer/consumer) needs
 * three live at once; the others reuse a subset. Threads are joined before the
 * next case runs, so sharing these across cases is safe. */
#define WORKER_STACK_SIZE 4096
#define WORKER_PRIO       5 /* preemptible, so producers and consumer interleave */

K_THREAD_STACK_DEFINE(stack_a, WORKER_STACK_SIZE);
K_THREAD_STACK_DEFINE(stack_b, WORKER_STACK_SIZE);
K_THREAD_STACK_DEFINE(stack_c, WORKER_STACK_SIZE);

static struct k_thread thread_a;
static struct k_thread thread_b;
static struct k_thread thread_c;

static sensor_manager_t mgr;

/* Encode a value into a sample such that any partially-written record is
 * detectable from the record alone. */
static void encode(int16_t v, int16_t accel[3], int16_t gyro[3])
{
    accel[0] = v;
    accel[1] = (int16_t)-v;
    accel[2] = (int16_t)(v ^ 0x5A5A);
    gyro[0]  = (int16_t)(v + 1);
    gyro[1]  = (int16_t)(v + 2);
    gyro[2]  = (int16_t)(v + 3);
}

static bool record_is_coherent(const sm_imu_sample_t *s)
{
    int16_t v = s->accel[0];

    return s->accel[1] == (int16_t)-v && s->accel[2] == (int16_t)(v ^ 0x5A5A) &&
           s->gyro[0] == (int16_t)(v + 1) && s->gyro[1] == (int16_t)(v + 2) &&
           s->gyro[2] == (int16_t)(v + 3);
}

/* ---- shared state ---- */

static atomic_int  g_producers_done;
static atomic_uint g_delivered;
static atomic_uint g_incoherent;
static atomic_uint g_seq_regressions;
static atomic_uint g_temp_delivered;

static void imu_producer(void *p1, void *p2, void *p3)
{
    int n = POINTER_TO_INT(p1);
    int i;

    ARG_UNUSED(p2);
    ARG_UNUSED(p3);

    for (i = 0; i < n; i++) {
        int16_t a[3], g[3];
        encode((int16_t)i, a, g);
        sm_submit_imu(&mgr, a, g, (uint64_t)i * 20000ull);
        if ((i & 0x3F) == 0) {
            k_yield(); /* widen the interleaving window */
        }
    }
    atomic_fetch_add(&g_producers_done, 1);
}

static void temp_producer(void *p1, void *p2, void *p3)
{
    int n = POINTER_TO_INT(p1);
    int i;

    ARG_UNUSED(p2);
    ARG_UNUSED(p3);

    for (i = 0; i < n; i++) {
        sm_submit_temp(&mgr, 33000 + (i % 500), (uint64_t)i * 1000000ull);
        if ((i & 0x1F) == 0) {
            k_yield();
        }
    }
    atomic_fetch_add(&g_producers_done, 1);
}

/* Drains both streams the way the BLE thread would: in bounded batches,
 * repeatedly, until the producers stop and the buffers are empty. */
static void consumer(void *p1, void *p2, void *p3)
{
    int      expected_producers = POINTER_TO_INT(p1);
    uint32_t last_seq           = 0;
    bool     have_last          = false;

    ARG_UNUSED(p2);
    ARG_UNUSED(p3);

    for (;;) {
        sm_imu_sample_t  ibuf[16];
        sm_temp_sample_t tbuf[16];
        size_t           n, i;
        bool             idle;

        n = sm_read_imu(&mgr, ibuf, 16);
        for (i = 0; i < n; i++) {
            if (!record_is_coherent(&ibuf[i])) {
                atomic_fetch_add(&g_incoherent, 1);
            }
            /* Sequence numbers must never go backwards within a stream. */
            if (have_last && ibuf[i].seq < last_seq) {
                atomic_fetch_add(&g_seq_regressions, 1);
            }
            last_seq  = ibuf[i].seq;
            have_last = true;
        }
        atomic_fetch_add(&g_delivered, (unsigned)n);
        idle = (n == 0);

        n = sm_read_temp(&mgr, tbuf, 16);
        atomic_fetch_add(&g_temp_delivered, (unsigned)n);
        idle = idle && (n == 0);

        if (idle && atomic_load(&g_producers_done) == expected_producers) {
            break; /* producers finished and buffers are drained */
        }
        if (idle) {
            k_yield();
        }
    }
}

static void reset_counters(void)
{
    atomic_store(&g_producers_done, 0);
    atomic_store(&g_delivered, 0);
    atomic_store(&g_incoherent, 0);
    atomic_store(&g_seq_regressions, 0);
    atomic_store(&g_temp_delivered, 0);
}

/*
 * One producer per stream plus a shared consumer: the production topology.
 */
ZTEST(concurrency, concurrent_producers_and_consumer_account_for_every_sample)
{
    int        n         = STRESS_SAMPLES;
    int        temp_n    = STRESS_SAMPLES / 20;
    int        producers = 2;
    sm_stats_t st;

    zassert_equal(sm_init(&mgr, 0), SM_OK);
    reset_counters();

    k_thread_create(&thread_c, stack_c, WORKER_STACK_SIZE, consumer,
                    INT_TO_POINTER(producers), NULL, NULL, WORKER_PRIO, 0, K_NO_WAIT);
    k_thread_create(&thread_a, stack_a, WORKER_STACK_SIZE, imu_producer,
                    INT_TO_POINTER(n), NULL, NULL, WORKER_PRIO, 0, K_NO_WAIT);
    k_thread_create(&thread_b, stack_b, WORKER_STACK_SIZE, temp_producer,
                    INT_TO_POINTER(temp_n), NULL, NULL, WORKER_PRIO, 0, K_NO_WAIT);

    k_thread_join(&thread_a, K_FOREVER);
    k_thread_join(&thread_b, K_FOREVER);
    k_thread_join(&thread_c, K_FOREVER);

    sm_get_stats(&mgr, &st);

    zassert_equal(st.imu.pushed, (uint32_t)n);
    zassert_equal(st.temp.pushed, (uint32_t)temp_n);

    /* The accounting identity. Every sample is delivered, dropped, or still
     * buffered - exactly once, never twice, never nowhere. */
    zassert_equal(atomic_load(&g_delivered) + st.imu.dropped + st.imu.count, (uint32_t)n);
    zassert_equal(atomic_load(&g_temp_delivered) + st.temp.dropped + st.temp.count,
                  (uint32_t)temp_n);

    /* No torn records and no sequence inversions. */
    zassert_equal(atomic_load(&g_incoherent), 0);
    zassert_equal(atomic_load(&g_seq_regressions), 0);

    sm_deinit(&mgr);
}

/*
 * Consumer deliberately starved: the phone is out of range. The buffer must
 * survive, keep only the latest 100, and report the loss exactly. This is the
 * concurrent version of the overflow requirement.
 */
ZTEST(concurrency, overflow_under_concurrency_is_counted_exactly)
{
    int             n = STRESS_SAMPLES;
    sm_stats_t      st;
    sm_imu_sample_t buf[SM_IMU_CAPACITY];
    size_t          got, i;

    zassert_equal(sm_init(&mgr, 0), SM_OK);
    reset_counters();

    k_thread_create(&thread_a, stack_a, WORKER_STACK_SIZE, imu_producer,
                    INT_TO_POINTER(n), NULL, NULL, WORKER_PRIO, 0, K_NO_WAIT);
    k_thread_join(&thread_a, K_FOREVER); /* nobody consumed anything */

    sm_get_stats(&mgr, &st);
    zassert_equal(st.imu.pushed, (uint32_t)n);
    zassert_equal(st.imu.count, SM_IMU_CAPACITY);
    zassert_equal(st.imu.dropped, (uint32_t)n - SM_IMU_CAPACITY);

    got = sm_read_imu(&mgr, buf, SM_IMU_CAPACITY);
    zassert_equal(got, SM_IMU_CAPACITY);
    for (i = 0; i < got; i++) {
        zassert_true(record_is_coherent(&buf[i]));
    }
    /* Retained window is the newest, and it is contiguous. */
    zassert_equal(buf[0].seq, (uint32_t)n - SM_IMU_CAPACITY);
    zassert_equal(buf[got - 1].seq, (uint32_t)n - 1);

    sm_deinit(&mgr);
}

/*
 * Contract violation, deliberately: two threads producing into one stream.
 * The documented contract is one producer per stream, but the sequence
 * counters are atomic specifically so that a violation degrades to
 * "records may be stored slightly out of order" rather than to corruption or
 * a duplicated sequence number. This test pins that degradation.
 */
ZTEST(concurrency, two_producers_on_one_stream_stay_memory_safe)
{
    int        n = 5000;
    sm_stats_t st;

    zassert_equal(sm_init(&mgr, 0), SM_OK);
    reset_counters();

    k_thread_create(&thread_a, stack_a, WORKER_STACK_SIZE, imu_producer,
                    INT_TO_POINTER(n), NULL, NULL, WORKER_PRIO, 0, K_NO_WAIT);
    k_thread_create(&thread_b, stack_b, WORKER_STACK_SIZE, imu_producer,
                    INT_TO_POINTER(n), NULL, NULL, WORKER_PRIO, 0, K_NO_WAIT);
    k_thread_join(&thread_a, K_FOREVER);
    k_thread_join(&thread_b, K_FOREVER);

    sm_get_stats(&mgr, &st);
    zassert_equal(st.imu.pushed, (uint32_t)(2 * n));
    zassert_equal(st.imu.count + st.imu.dropped, (uint32_t)(2 * n));

    /* Every retained record is still internally coherent: no interleaved
     * half-writes even with the contract broken. */
    {
        sm_imu_sample_t buf[SM_IMU_CAPACITY];
        size_t          got = sm_read_imu(&mgr, buf, SM_IMU_CAPACITY);
        size_t          i;
        for (i = 0; i < got; i++) {
            zassert_true(record_is_coherent(&buf[i]));
        }
    }
    sm_deinit(&mgr);
}

ZTEST_SUITE(concurrency, NULL, NULL, NULL, NULL, NULL);
```

## src/test_ringbuf.c
```c
/*
 * Ring buffer unit tests, ported from the custom harness to Ztest.
 *
 * The core is built here against SM_PORT_ZEPHYR (the live firmware port), but
 * these cases stay single-threaded and deterministic, so a failure is a logic
 * bug and never a race. Assertion intent is unchanged from tests/test_ringbuf.c;
 * only the harness (TEST/CHECK -> ZTEST/zassert) is different.
 */
#include <string.h>

#include <zephyr/ztest.h>

#include "sm_ringbuf.h"

#define CAP 8

static sm_rb_t  rb;
static uint32_t store[CAP];

static void setup(void)
{
    memset(store, 0, sizeof(store));
    zassert_equal(sm_rb_init(&rb, store, sizeof(uint32_t), CAP), 0);
}

ZTEST(ringbuf, init_rejects_bad_arguments)
{
    sm_rb_t  bad;
    uint32_t s[4];

    zassert_equal(sm_rb_init(&bad, NULL, 4, 4), -1);
    zassert_equal(sm_rb_init(&bad, s, 0, 4), -1);
    zassert_equal(sm_rb_init(&bad, s, 4, 0), -1);
    zassert_equal(sm_rb_init(NULL, s, 4, 4), -1);
}

ZTEST(ringbuf, empty_buffer_yields_nothing)
{
    uint32_t out[CAP];

    setup();
    zassert_equal(sm_rb_count(&rb), 0);
    zassert_equal(sm_rb_read(&rb, out, CAP), 0);
    zassert_equal(sm_rb_peek(&rb, out, CAP), 0);
    zassert_equal(sm_rb_consume(&rb, 5), 0);
}

ZTEST(ringbuf, fifo_order_is_preserved)
{
    uint32_t out[CAP];
    uint32_t i;

    setup();
    for (i = 0; i < 5; i++) {
        zassert_equal(sm_rb_push(&rb, &i), false);
    }
    zassert_equal(sm_rb_count(&rb), 5);
    zassert_equal(sm_rb_read(&rb, out, CAP), 5);
    for (i = 0; i < 5; i++) {
        zassert_equal(out[i], i); /* oldest first */
    }
    zassert_equal(sm_rb_count(&rb), 0);
}

ZTEST(ringbuf, fills_to_capacity_without_dropping)
{
    sm_rb_stats_t st;
    uint32_t      i;

    setup();
    for (i = 0; i < CAP; i++) {
        zassert_equal(sm_rb_push(&rb, &i), false); /* nothing evicted yet */
    }
    sm_rb_stats(&rb, &st);
    zassert_equal(st.count, CAP);
    zassert_equal(st.pushed, CAP);
    zassert_equal(st.dropped, 0);
}

/*
 * The core requirement: on overflow the buffer must retain the LATEST N,
 * not the first N, and must say how many it lost.
 */
ZTEST(ringbuf, overflow_retains_latest_and_counts_drops)
{
    uint32_t      out[CAP];
    sm_rb_stats_t st;
    uint32_t      i;

    setup();
    for (i = 0; i < CAP + 5; i++) {
        bool evicted = sm_rb_push(&rb, &i);
        zassert_equal(evicted, i >= CAP); /* eviction starts exactly at capacity */
    }

    sm_rb_stats(&rb, &st);
    zassert_equal(st.count, CAP);
    zassert_equal(st.pushed, CAP + 5);
    zassert_equal(st.dropped, 5);

    zassert_equal(sm_rb_read(&rb, out, CAP), CAP);
    for (i = 0; i < CAP; i++) {
        zassert_equal(out[i], i + 5); /* 0..4 were evicted; 5..12 survive */
    }
}

/* Wraparound is where ring buffers die. Push far past capacity, interleaved
 * with reads, and check the contents every time. */
ZTEST(ringbuf, wraparound_stays_correct_over_many_cycles)
{
    uint32_t out[CAP];
    uint32_t v, round;

    setup();
    v = 0;
    for (round = 0; round < 50; round++) {
        uint32_t n = (round % 3) + 1; /* uneven push/read sizes */
        uint32_t i;

        for (i = 0; i < n; i++, v++) {
            sm_rb_push(&rb, &v);
        }
        zassert_equal(sm_rb_read(&rb, out, n), n);
        for (i = 0; i < n; i++) {
            zassert_equal(out[i], v - n + i);
        }
        zassert_equal(sm_rb_count(&rb), 0);
    }
}

ZTEST(ringbuf, partial_read_leaves_remainder_in_order)
{
    uint32_t out[CAP];
    uint32_t i;

    setup();
    for (i = 0; i < 6; i++) {
        sm_rb_push(&rb, &i);
    }
    zassert_equal(sm_rb_read(&rb, out, 2), 2);
    zassert_equal(out[0], 0);
    zassert_equal(out[1], 1);
    zassert_equal(sm_rb_count(&rb), 4);

    zassert_equal(sm_rb_read(&rb, out, CAP), 4);
    zassert_equal(out[0], 2);
    zassert_equal(out[3], 5);
}

ZTEST(ringbuf, read_of_more_than_available_returns_what_exists)
{
    uint32_t out[CAP * 2];
    uint32_t i;

    setup();
    for (i = 0; i < 3; i++) {
        sm_rb_push(&rb, &i);
    }
    zassert_equal(sm_rb_read(&rb, out, CAP * 2), 3);
}

ZTEST(ringbuf, peek_does_not_consume)
{
    uint32_t out[CAP];
    uint32_t i;

    setup();
    for (i = 0; i < 4; i++) {
        sm_rb_push(&rb, &i);
    }

    zassert_equal(sm_rb_peek(&rb, out, CAP), 4);
    zassert_equal(sm_rb_count(&rb), 4); /* still there */
    zassert_equal(sm_rb_peek(&rb, out, CAP), 4);
    zassert_equal(out[0], 0);

    /* peek-then-release is the retryable-notification path */
    zassert_equal(sm_rb_consume(&rb, 2), 2);
    zassert_equal(sm_rb_count(&rb), 2);
    zassert_equal(sm_rb_peek(&rb, out, CAP), 2);
    zassert_equal(out[0], 2);
}

ZTEST(ringbuf, consume_clamps_to_available)
{
    uint32_t i;

    setup();
    for (i = 0; i < 3; i++) {
        sm_rb_push(&rb, &i);
    }
    zassert_equal(sm_rb_consume(&rb, 99), 3);
    zassert_equal(sm_rb_count(&rb), 0);
}

ZTEST(ringbuf, reset_clears_records_but_keeps_lifetime_counters)
{
    sm_rb_stats_t st;
    uint32_t      i;

    setup();
    for (i = 0; i < CAP + 2; i++) {
        sm_rb_push(&rb, &i);
    }
    sm_rb_reset(&rb);

    sm_rb_stats(&rb, &st);
    zassert_equal(st.count, 0);
    zassert_equal(st.pushed, CAP + 2); /* diagnostics survive a reset */
    zassert_equal(st.dropped, 2);
}

/* A capacity-1 buffer is the degenerate case that off-by-one bugs love. */
ZTEST(ringbuf, capacity_one_behaves)
{
    sm_rb_t  one;
    uint32_t s[1];
    uint32_t out[1];
    uint32_t v;

    zassert_equal(sm_rb_init(&one, s, sizeof(uint32_t), 1), 0);
    v = 11;
    zassert_equal(sm_rb_push(&one, &v), false);
    v = 22;
    zassert_equal(sm_rb_push(&one, &v), true);
    zassert_equal(sm_rb_count(&one), 1);
    zassert_equal(sm_rb_read(&one, out, 1), 1);
    zassert_equal(out[0], 22);
    sm_rb_deinit(&one);
}

ZTEST(ringbuf, non_power_of_two_capacity_is_supported)
{
    /* The product capacities are 100 and 20. Neither is a power of two, so
     * the implementation must not depend on mask-based wrapping. */
    sm_rb_t odd;
    uint8_t s[100];
    uint8_t out[100];
    int     i;

    zassert_equal(sm_rb_init(&odd, s, 1, 100), 0);
    for (i = 0; i < 250; i++) {
        uint8_t v = (uint8_t)i;
        sm_rb_push(&odd, &v);
    }
    zassert_equal(sm_rb_count(&odd), 100);
    zassert_equal(sm_rb_read(&odd, out, 100), 100);
    for (i = 0; i < 100; i++) {
        zassert_equal(out[i], (uint8_t)(150 + i)); /* latest 100 of 0..249 */
    }
    sm_rb_deinit(&odd);
}

ZTEST_SUITE(ringbuf, NULL, NULL, NULL, NULL, NULL);
```

## src/test_sensor_manager.c
```c
/*
 * Sensor manager tests: rate control, sequencing, retention, gap reporting.
 * Ported from tests/test_sensor_manager.c to Ztest. Injected virtual time keeps
 * every case deterministic; the SM_PORT_ZEPHYR locks are exercised but never
 * contended here. Assertion intent is unchanged from the original.
 */
#include <string.h>

#include <zephyr/ztest.h>

#include "sensor_manager.h"
#include "sensor_sim.h"

static sensor_manager_t mgr;

static const int16_t A[3] = {1, 2, 3};
static const int16_t G[3] = {4, 5, 6};

/* Virtual-time run length shared by the drift-free and simulated-run cases. */
#define TEN_SECONDS_US 10000000ull
#define POLL_STEP_US   1000ull

/* ---------------- rate control ---------------- */

ZTEST(sensor_manager, rate_not_due_before_first_period)
{
    sm_rate_t r;

    sm_rate_init(&r, 50, 0);
    zassert_equal(sm_rate_poll(&r, 0), 0);
    zassert_equal(sm_rate_poll(&r, 19999), 0);
    zassert_equal(sm_rate_poll(&r, 20000), 1); /* 50 Hz => 20 ms */
}

/*
 * The headline property: exactly rate*seconds firings, with no accumulated
 * drift, even when every poll arrives slightly late.
 */
ZTEST(sensor_manager, rate_is_drift_free_over_ten_seconds)
{
    sm_rate_t imu, temp;
    uint32_t  imu_total = 0, temp_total = 0;
    uint64_t  t;

    sm_rate_init(&imu, SM_IMU_RATE_HZ, 0);
    sm_rate_init(&temp, SM_TEMP_RATE_HZ, 0);

    /* Poll every 1 ms with a 300 us jitter that always runs late. A naive
     * "next = now + period" scheduler would lose ~15 samples over this run. */
    for (t = 0; t <= TEN_SECONDS_US; t += POLL_STEP_US) {
        imu_total += sm_rate_poll(&imu, t + 300);
        temp_total += sm_rate_poll(&temp, t + 300);
    }

    zassert_equal(imu_total, 500); /* 50 Hz x 10 s, exactly */
    zassert_equal(temp_total, 10); /*  1 Hz x 10 s, exactly */
    zassert_equal(imu.missed, 0);
    zassert_equal(temp.missed, 0);
}

ZTEST(sensor_manager, rate_catches_up_a_short_stall)
{
    sm_rate_t r;

    sm_rate_init(&r, 50, 0);
    /* 60 ms late => 3 periods due, within the catch-up clamp. */
    zassert_equal(sm_rate_poll(&r, 60000), 3);
    zassert_equal(r.missed, 0);
}

/*
 * A long stall must not produce a burst that evicts the recent data still in
 * the buffer. The clamp trades completeness for recency and reports the loss.
 */
ZTEST(sensor_manager, rate_clamps_a_long_stall_and_reports_it)
{
    sm_rate_t r;
    uint32_t  due;

    sm_rate_init(&r, 50, 0);
    due = sm_rate_poll(&r, 2000000); /* 2 s stall = 100 periods */

    zassert_equal(due, SM_RATE_MAX_CATCHUP);
    zassert_equal(r.missed, 100 - SM_RATE_MAX_CATCHUP);

    /* Phase must have resynchronised to the stall's end, not stayed behind. */
    zassert_equal(sm_rate_poll(&r, 2000000), 0);
    zassert_equal(sm_rate_poll(&r, 2020000), 1);
}

ZTEST(sensor_manager, rate_zero_hz_never_fires)
{
    sm_rate_t r;

    sm_rate_init(&r, 0, 0);
    zassert_equal(sm_rate_poll(&r, 1000000000ull), 0);
}

/* ---------------- manager ---------------- */

ZTEST(sensor_manager, init_gives_empty_buffers_at_configured_capacity)
{
    sm_stats_t st;

    zassert_equal(sm_init(&mgr, 0), SM_OK);
    sm_get_stats(&mgr, &st);

    zassert_equal(st.imu.capacity, SM_IMU_CAPACITY);
    zassert_equal(st.temp.capacity, SM_TEMP_CAPACITY);
    zassert_equal(st.imu.count, 0);
    zassert_equal(st.temp.count, 0);
    zassert_equal(sm_init(NULL, 0), SM_ERR_ARG);

    sm_deinit(&mgr);
}

ZTEST(sensor_manager, submitted_samples_round_trip_intact)
{
    sm_imu_sample_t  out[4];
    sm_temp_sample_t tout[4];

    zassert_equal(sm_init(&mgr, 0), SM_OK);
    sm_submit_imu(&mgr, A, G, 1234);
    sm_submit_temp(&mgr, 33500, 5678);

    zassert_equal(sm_read_imu(&mgr, out, 4), 1);
    zassert_equal(out[0].t_us, 1234);
    zassert_equal(out[0].accel[0], 1);
    zassert_equal(out[0].accel[2], 3);
    zassert_equal(out[0].gyro[0], 4);
    zassert_equal(out[0].gyro[2], 6);

    zassert_equal(sm_read_temp(&mgr, tout, 4), 1);
    zassert_equal(tout[0].t_us, 5678);
    zassert_equal(tout[0].milli_celsius, 33500);

    sm_deinit(&mgr);
}

ZTEST(sensor_manager, sequence_numbers_are_monotonic_and_dense_when_not_dropping)
{
    sm_imu_sample_t out[10];
    int             i;

    zassert_equal(sm_init(&mgr, 0), SM_OK);
    for (i = 0; i < 10; i++) {
        sm_submit_imu(&mgr, A, G, (uint64_t)i * 20000);
    }
    zassert_equal(sm_read_imu(&mgr, out, 10), 10);
    for (i = 0; i < 10; i++) {
        zassert_equal(out[i].seq, i);
    }
    sm_deinit(&mgr);
}

ZTEST(sensor_manager, imu_retains_latest_100)
{
    sm_imu_sample_t out[SM_IMU_CAPACITY];
    sm_stats_t      st;
    int             i;

    zassert_equal(sm_init(&mgr, 0), SM_OK);
    for (i = 0; i < 150; i++) {
        sm_submit_imu(&mgr, A, G, (uint64_t)i * 20000);
    }

    sm_get_stats(&mgr, &st);
    zassert_equal(st.imu.count, SM_IMU_CAPACITY);
    zassert_equal(st.imu.pushed, 150);
    zassert_equal(st.imu.dropped, 50);

    zassert_equal(sm_read_imu(&mgr, out, SM_IMU_CAPACITY), SM_IMU_CAPACITY);
    zassert_equal(out[0].seq, 50); /* the 50 oldest were evicted */
    zassert_equal(out[99].seq, 149);
    sm_deinit(&mgr);
}

ZTEST(sensor_manager, temp_retains_latest_20)
{
    sm_temp_sample_t out[SM_TEMP_CAPACITY];
    sm_stats_t       st;
    int              i;

    zassert_equal(sm_init(&mgr, 0), SM_OK);
    for (i = 0; i < 35; i++) {
        sm_submit_temp(&mgr, 33000 + i, (uint64_t)i * 1000000);
    }

    sm_get_stats(&mgr, &st);
    zassert_equal(st.temp.count, SM_TEMP_CAPACITY);
    zassert_equal(st.temp.dropped, 15);

    zassert_equal(sm_read_temp(&mgr, out, SM_TEMP_CAPACITY), SM_TEMP_CAPACITY);
    zassert_equal(out[0].milli_celsius, 33000 + 15);
    zassert_equal(out[19].milli_celsius, 33000 + 34);
    sm_deinit(&mgr);
}

/*
 * Overflow must be *detectable downstream*, not just survivable. The gap in
 * sequence numbers across a drop is what the phone uses to know its timeline
 * is incomplete. This is the difference between graceful and silent.
 */
ZTEST(sensor_manager, overflow_leaves_a_detectable_sequence_gap)
{
    sm_imu_sample_t out[SM_IMU_CAPACITY];
    uint32_t        last_seq;
    int             i;

    zassert_equal(sm_init(&mgr, 0), SM_OK);

    for (i = 0; i < 10; i++) {
        sm_submit_imu(&mgr, A, G, (uint64_t)i * 20000);
    }
    zassert_equal(sm_read_imu(&mgr, out, 10), 10);
    last_seq = out[9].seq;

    /* Consumer goes away (phone out of range) and the buffer overruns. */
    for (i = 10; i < 10 + 250; i++) {
        sm_submit_imu(&mgr, A, G, (uint64_t)i * 20000);
    }

    zassert_equal(sm_read_imu(&mgr, out, SM_IMU_CAPACITY), SM_IMU_CAPACITY);
    zassert_true(out[0].seq > last_seq + 1);         /* a gap exists */
    zassert_equal(out[0].seq - last_seq - 1, 150);   /* and it is exactly 150 */
    sm_deinit(&mgr);
}

ZTEST(sensor_manager, streams_are_independent)
{
    sm_stats_t st;
    int        i;

    zassert_equal(sm_init(&mgr, 0), SM_OK);
    for (i = 0; i < 200; i++) {
        sm_submit_imu(&mgr, A, G, (uint64_t)i);
    }
    sm_submit_temp(&mgr, 33000, 1);

    sm_get_stats(&mgr, &st);
    zassert_equal(st.imu.dropped, 100);
    zassert_equal(st.temp.dropped, 0); /* IMU overrun must not disturb temp */
    zassert_equal(st.temp.count, 1);
    sm_deinit(&mgr);
}

ZTEST(sensor_manager, peek_release_supports_a_retried_notification)
{
    sm_imu_sample_t out[8];
    int             i;

    zassert_equal(sm_init(&mgr, 0), SM_OK);
    for (i = 0; i < 8; i++) {
        sm_submit_imu(&mgr, A, G, (uint64_t)i);
    }

    /* First attempt: stack refuses, nothing released. */
    zassert_equal(sm_peek_imu(&mgr, out, 8), 8);
    zassert_equal(sm_pending_imu(&mgr), 8);

    /* Retry: stack accepts 5 of them. */
    zassert_equal(sm_peek_imu(&mgr, out, 8), 8);
    zassert_equal(out[0].seq, 0);
    zassert_equal(sm_release_imu(&mgr, 5), 5);
    zassert_equal(sm_pending_imu(&mgr), 3);
    zassert_equal(sm_peek_imu(&mgr, out, 8), 3);
    zassert_equal(out[0].seq, 5); /* resumes exactly where it left off */

    sm_deinit(&mgr);
}

/* The temperature stream has its own peek/release entry points; exercise them
 * directly rather than assuming they mirror the IMU path they wrap. */
ZTEST(sensor_manager, temp_peek_release_supports_a_retried_notification)
{
    sm_temp_sample_t out[8];
    int              i;

    zassert_equal(sm_init(&mgr, 0), SM_OK);
    for (i = 0; i < 6; i++) {
        sm_submit_temp(&mgr, 33000 + i, (uint64_t)i * 1000000ull);
    }

    /* First attempt is peeked but not released: everything stays pending. */
    zassert_equal(sm_peek_temp(&mgr, out, 8), 6);
    zassert_equal(sm_pending_temp(&mgr), 6);
    zassert_equal(out[0].milli_celsius, 33000);

    /* Stack accepts 4; the remainder must resume exactly where it left off. */
    zassert_equal(sm_release_temp(&mgr, 4), 4);
    zassert_equal(sm_pending_temp(&mgr), 2);
    zassert_equal(sm_peek_temp(&mgr, out, 8), 2);
    zassert_equal(out[0].milli_celsius, 33000 + 4);

    sm_deinit(&mgr);
}

/* End-to-end: drive the manager from the simulator through 10 s of virtual
 * time and assert the sample counts the requirements specify. */
ZTEST(sensor_manager, simulated_ten_second_run_produces_expected_rates)
{
    sensor_sim_t sim;
    sm_stats_t   st;
    uint64_t     t;

    zassert_equal(sm_init(&mgr, 0), SM_OK);
    sensor_sim_init(&sim, 0xC0FFEEu);

    for (t = 0; t <= TEN_SECONDS_US; t += POLL_STEP_US) {
        uint32_t n = sm_rate_poll(&mgr.imu_rate, t);
        while (n--) {
            int16_t a[3], g[3];
            sensor_sim_imu(&sim, a, g);
            sm_submit_imu(&mgr, a, g, t);
        }
        n = sm_rate_poll(&mgr.temp_rate, t);
        while (n--) {
            sm_submit_temp(&mgr, sensor_sim_temp(&sim), t);
        }
    }

    sm_get_stats(&mgr, &st);
    zassert_equal(st.imu.pushed, 500);
    zassert_equal(st.temp.pushed, 10);
    /* Nothing was ever drained, so the buffers are full and the excess is
     * accounted for exactly. */
    zassert_equal(st.imu.count, SM_IMU_CAPACITY);
    zassert_equal(st.imu.dropped, 500 - SM_IMU_CAPACITY);
    zassert_equal(st.temp.count, 10);
    zassert_equal(st.temp.dropped, 0);
    sm_deinit(&mgr);
}

ZTEST(sensor_manager, simulator_is_deterministic)
{
    sensor_sim_t a, b;
    int          i;

    sensor_sim_init(&a, 42);
    sensor_sim_init(&b, 42);
    for (i = 0; i < 100; i++) {
        int16_t aa[3], ag[3], ba[3], bg[3];
        sensor_sim_imu(&a, aa, ag);
        sensor_sim_imu(&b, ba, bg);
        zassert_equal(memcmp(aa, ba, sizeof(aa)), 0);
        zassert_equal(memcmp(ag, bg, sizeof(ag)), 0);
    }
}

ZTEST(sensor_manager, simulated_signals_are_in_plausible_range)
{
    sensor_sim_t sim;
    int          i;

    sensor_sim_init(&sim, 7);
    for (i = 0; i < 500; i++) {
        int16_t a[3], g[3];
        int32_t c;

        sensor_sim_imu(&sim, a, g);
        c = sensor_sim_temp(&sim);

        /* Z axis should sit near 1 g (4096 LSB at +/-8g FS). */
        zassert_true(a[2] > 3800 && a[2] < 4400);
        /* Skin temperature stays in a physiological band. */
        zassert_true(c > 28000 && c < 38000);
    }
}

ZTEST_SUITE(sensor_manager, NULL, NULL, NULL, NULL, NULL);
```
